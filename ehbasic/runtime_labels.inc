; Generated by tools/gen_runtime_abi_docs.py. Do not edit.
; Runtime label hash table for ADDR("LABEL") in the extension ROM.

RUNTIME_LABEL_BUCKET_COUNT = 64
RUNTIME_LABEL_COUNT = 120

RuntimeLabelBuckets:
      .word @bucket_00
      .word @bucket_01
      .word @bucket_02
      .word @bucket_03
      .word @bucket_04
      .word @bucket_05
      .word @bucket_06
      .word @bucket_07
      .word @bucket_08
      .word @bucket_09
      .word @bucket_0A
      .word @bucket_0B
      .word @bucket_0C
      .word @bucket_0D
      .word @bucket_0E
      .word @bucket_0F
      .word @bucket_10
      .word @bucket_11
      .word @bucket_12
      .word @bucket_13
      .word @bucket_14
      .word @bucket_15
      .word @bucket_16
      .word @bucket_17
      .word @bucket_18
      .word @bucket_19
      .word @bucket_1A
      .word @bucket_1B
      .word @bucket_1C
      .word @bucket_1D
      .word @bucket_1E
      .word @bucket_1F
      .word @bucket_20
      .word @bucket_21
      .word @bucket_22
      .word @bucket_23
      .word @bucket_24
      .word @bucket_25
      .word @bucket_26
      .word @bucket_27
      .word @bucket_28
      .word @bucket_29
      .word @bucket_2A
      .word @bucket_2B
      .word @bucket_2C
      .word @bucket_2D
      .word @bucket_2E
      .word @bucket_2F
      .word @bucket_30
      .word @bucket_31
      .word @bucket_32
      .word @bucket_33
      .word @bucket_34
      .word @bucket_35
      .word @bucket_36
      .word @bucket_37
      .word @bucket_38
      .word @bucket_39
      .word @bucket_3A
      .word @bucket_3B
      .word @bucket_3C
      .word @bucket_3D
      .word @bucket_3E
      .word @bucket_3F

@bucket_00:
      .byte 0

@bucket_01:
      .byte 13
      .word $B9A9
      .byte "AUDIO.RELEASE"
      .byte 10
      .word $B9A7
      .byte "AUDIO.STRH"
      .byte 0

@bucket_02:
      .byte 20
      .word $EDE3
      .byte "AUDIO.MUSIC_PRIORITY"
      .byte 9
      .word $ED64
      .byte "FIO.GSAVE"
      .byte 0

@bucket_03:
      .byte 16
      .word $ED92
      .byte "AUDIO.SET_VOLUME"
      .byte 19
      .word $0028
      .byte "FIO.CMD_LOADRUNTIME"
      .byte 13
      .word $EE32
      .byte "NIC.COPY_NAME"
      .byte 8
      .word $00E8
      .byte "SYS.REGX"
      .byte 0

@bucket_04:
      .byte 17
      .word $EDEC
      .byte "AUDIO.SFX_PLAYING"
      .byte 8
      .word $00E9
      .byte "SYS.REGY"
      .byte 15
      .word $E90D
      .byte "VGC.REVERSE_OFF"
      .byte 0

@bucket_05:
      .byte 17
      .word $EDD9
      .byte "AUDIO.MUSIC_TEMPO"
      .byte 10
      .word $B9A6
      .byte "AUDIO.STRL"
      .byte 0

@bucket_06:
      .byte 11
      .word $B9A7
      .byte "AUDIO.DECAY"
      .byte 10
      .word $E8D4
      .byte "VGC.LOCATE"
      .byte 0

@bucket_07:
      .byte 13
      .word $B9A8
      .byte "AUDIO.SUSTAIN"
      .byte 13
      .word $ED2E
      .byte "FIO.COPY_NAME"
      .byte 0

@bucket_08:
      .byte 24
      .word $E986
      .byte "SPRITE.BACKGROUND_STATUS"
      .byte 0

@bucket_09:
      .byte 11
      .word $ED9A
      .byte "AUDIO.SOUND"
      .byte 0

@bucket_0A:
      .byte 0

@bucket_0B:
      .byte 20
      .word $E8FF
      .byte "VGC.REVERSE_EXPLICIT"
      .byte 0

@bucket_0C:
      .byte 12
      .word $0027
      .byte "FIO.ARG_LENH"
      .byte 11
      .word $B9A3
      .byte "FIO.NAMELEN"
      .byte 0

@bucket_0D:
      .byte 0

@bucket_0E:
      .byte 9
      .word $0025
      .byte "XRAM.RAMH"
      .byte 0

@bucket_0F:
      .byte 18
      .word $B9A4
      .byte "AUDIO.VOLUME_LEVEL"
      .byte 16
      .word $ED82
      .byte "FIO.LOAD_RUNTIME"
      .byte 0

@bucket_10:
      .byte 12
      .word $0026
      .byte "FIO.ARG_LENL"
      .byte 7
      .word $E8C2
      .byte "VGC.CLS"
      .byte 12
      .word $E8E5
      .byte "VGC.SET_FONT"
      .byte 0

@bucket_11:
      .byte 8
      .word $ECFC
      .byte "FIO.EXEC"
      .byte 0

@bucket_12:
      .byte 9
      .word $0024
      .byte "XRAM.RAML"
      .byte 0

@bucket_13:
      .byte 6
      .word $ED6E
      .byte "FIO.CD"
      .byte 0

@bucket_14:
      .byte 19
      .word $EDF2
      .byte "AUDIO.MUSIC_PLAYING"
      .byte 0

@bucket_15:
      .byte 0

@bucket_16:
      .byte 16
      .word $EDFC
      .byte "AUDIO.MUSIC_NOTE"
      .byte 10
      .word $B9A4
      .byte "AUDIO.NOTE"
      .byte 11
      .word $B9A5
      .byte "AUDIO.VOICE"
      .byte 13
      .word $E91F
      .byte "VGC.FLASH_OFF"
      .byte 0

@bucket_17:
      .byte 0

@bucket_18:
      .byte 12
      .word $B9A6
      .byte "AUDIO.ATTACK"
      .byte 12
      .word $ED9F
      .byte "AUDIO.VOLUME"
      .byte 12
      .word $E916
      .byte "VGC.FLASH_ON"
      .byte 0

@bucket_19:
      .byte 16
      .word $B9A6
      .byte "AUDIO.INSTRUMENT"
      .byte 12
      .word $EDC1
      .byte "AUDIO.SFLOAD"
      .byte 14
      .word $E936
      .byte "SPRITE.DISABLE"
      .byte 0

@bucket_1A:
      .byte 0

@bucket_1B:
      .byte 0

@bucket_1C:
      .byte 15
      .word $ED0F
      .byte "FIO.CLEAR_ERROR"
      .byte 12
      .word $ED55
      .byte "FIO.DIR_OPEN"
      .byte 0

@bucket_1D:
      .byte 0

@bucket_1E:
      .byte 16
      .word $ED87
      .byte "AUDIO.PLAY_SOUND"
      .byte 12
      .word $E8E1
      .byte "VGC.SET_MODE"
      .byte 0

@bucket_1F:
      .byte 10
      .word $ED5F
      .byte "FIO.DELETE"
      .byte 17
      .word $0022
      .byte "NIC.ARG_NAMEPTR_H"
      .byte 0

@bucket_20:
      .byte 13
      .word $EDBC
      .byte "AUDIO.MIDSTOP"
      .byte 9
      .word $0023
      .byte "XRAM.DATA"
      .byte 0

@bucket_21:
      .byte 15
      .word $0020
      .byte "NIC.ARG_NAMELEN"
      .byte 16
      .word $E94B
      .byte "SPRITE.SET_SHAPE"
      .byte 9
      .word $E8B9
      .byte "VGC.VSYNC"
      .byte 16
      .word $E8B1
      .byte "VGC.WAIT_COMMAND"
      .byte 0

@bucket_22:
      .byte 10
      .word $E8CC
      .byte "VGC.SET_BG"
      .byte 0

@bucket_23:
      .byte 17
      .word $002A
      .byte "FIO.ARG_NAMEPTR_H"
      .byte 9
      .word $ED73
      .byte "FIO.MKDIR"
      .byte 17
      .word $0021
      .byte "NIC.ARG_NAMEPTR_L"
      .byte 0

@bucket_24:
      .byte 20
      .word $EDA4
      .byte "AUDIO.INSTRUMENT_SET"
      .byte 12
      .word $EDE8
      .byte "AUDIO.STATUS"
      .byte 14
      .word $E928
      .byte "SPRITE.COMMAND"
      .byte 14
      .word $002A
      .byte "XRAM.NAMEPTR_H"
      .byte 0

@bucket_25:
      .byte 15
      .word $0028
      .byte "FIO.ARG_NAMELEN"
      .byte 0

@bucket_26:
      .byte 14
      .word $B9A5
      .byte "AUDIO.DURATION"
      .byte 16
      .word $EDD4
      .byte "AUDIO.MUSIC_STOP"
      .byte 13
      .word $EDB2
      .byte "AUDIO.SIDSTOP"
      .byte 12
      .word $ED5A
      .byte "FIO.DIR_READ"
      .byte 15
      .word $E94D
      .byte "SPRITE.SET_REG8"
      .byte 10
      .word $E8C8
      .byte "VGC.SET_FG"
      .byte 12
      .word $0028
      .byte "XRAM.NAMELEN"
      .byte 0

@bucket_27:
      .byte 14
      .word $B9A5
      .byte "AUDIO.WAVEFORM"
      .byte 17
      .word $0029
      .byte "FIO.ARG_NAMEPTR_L"
      .byte 11
      .word $EE08
      .byte "NIC.COMMAND"
      .byte 0

@bucket_28:
      .byte 13
      .word $0022
      .byte "FIO.ARG_ADDRH"
      .byte 12
      .word $E8E9
      .byte "VGC.MEM_READ"
      .byte 14
      .word $0029
      .byte "XRAM.NAMEPTR_L"
      .byte 0

@bucket_29:
      .byte 17
      .word $E940
      .byte "SPRITE.REG_OFFSET"
      .byte 10
      .word $0022
      .byte "XRAM.ADDRH"
      .byte 0

@bucket_2A:
      .byte 13
      .word $B9A4
      .byte "AUDIO.INST_ID"
      .byte 9
      .word $ECEF
      .byte "FIO.CHECK"
      .byte 9
      .word $ED78
      .byte "FIO.RMDIR"
      .byte 10
      .word $EE2E
      .byte "NIC.LENGTH"
      .byte 11
      .word $E8F4
      .byte "VGC.REVERSE"
      .byte 0

@bucket_2B:
      .byte 0

@bucket_2C:
      .byte 13
      .word $0020
      .byte "FIO.ARG_ADDRL"
      .byte 8
      .word $ED50
      .byte "FIO.LOAD"
      .byte 10
      .word $EE1C
      .byte "NIC.STATUS"
      .byte 13
      .word $E931
      .byte "SPRITE.ENABLE"
      .byte 8
      .word $00E7
      .byte "SYS.REGA"
      .byte 0

@bucket_2D:
      .byte 13
      .word $0021
      .byte "FIO.ARG_ADDRM"
      .byte 8
      .word $B9B0
      .byte "FIO.NAME"
      .byte 11
      .word $E8AD
      .byte "VGC.COMMAND"
      .byte 10
      .word $0020
      .byte "XRAM.ADDRL"
      .byte 9
      .word $0027
      .byte "XRAM.LENH"
      .byte 0

@bucket_2E:
      .byte 10
      .word $0021
      .byte "XRAM.ADDRM"
      .byte 0

@bucket_2F:
      .byte 0

@bucket_30:
      .byte 13
      .word $EDB7
      .byte "AUDIO.MIDPLAY"
      .byte 0

@bucket_31:
      .byte 9
      .word $0026
      .byte "XRAM.LENL"
      .byte 0

@bucket_32:
      .byte 11
      .word $EE0C
      .byte "NIC.CONNECT"
      .byte 14
      .word $EE10
      .byte "NIC.DISCONNECT"
      .byte 8
      .word $EE14
      .byte "NIC.SEND"
      .byte 0

@bucket_33:
      .byte 9
      .word $ED69
      .byte "FIO.GLOAD"
      .byte 0

@bucket_34:
      .byte 23
      .word $E982
      .byte "SPRITE.COLLISION_STATUS"
      .byte 0

@bucket_35:
      .byte 9
      .word $ECEB
      .byte "FIO.ISSUE"
      .byte 16
      .word $E958
      .byte "SPRITE.SET_REG16"
      .byte 0

@bucket_36:
      .byte 16
      .word $EDCB
      .byte "AUDIO.MUSIC_PLAY"
      .byte 13
      .word $EDA9
      .byte "AUDIO.SIDPLAY"
      .byte 0

@bucket_37:
      .byte 7
      .word $ED7D
      .byte "FIO.PWD"
      .byte 10
      .word $E92C
      .byte "SPRITE.POS"
      .byte 13
      .word $E8EC
      .byte "VGC.MEM_WRITE"
      .byte 14
      .word $E8D0
      .byte "VGC.SET_BORDER"
      .byte 0

@bucket_38:
      .byte 12
      .word $B9A3
      .byte "AUDIO.STRLEN"
      .byte 16
      .word $ED21
      .byte "FIO.SET_IO_ERROR"
      .byte 8
      .word $EE18
      .byte "NIC.RECV"
      .byte 0

@bucket_39:
      .byte 20
      .word $EDC6
      .byte "AUDIO.MUSIC_SEQUENCE"
      .byte 0

@bucket_3A:
      .byte 16
      .word $EDDE
      .byte "AUDIO.MUSIC_LOOP"
      .byte 0

@bucket_3B:
      .byte 8
      .word $ED4B
      .byte "FIO.SAVE"
      .byte 15
      .word $0002
      .byte "ROMSWAP.PRIMARY"
      .byte 0

@bucket_3C:
      .byte 12
      .word $E967
      .byte "SPRITE.GET_X"
      .byte 0

@bucket_3D:
      .byte 9
      .word $EE24
      .byte "NIC.READY"
      .byte 12
      .word $E978
      .byte "SPRITE.GET_Y"
      .byte 10
      .word $E93B
      .byte "SPRITE.ROW"
      .byte 0

@bucket_3E:
      .byte 0

@bucket_3F:
      .byte 0
